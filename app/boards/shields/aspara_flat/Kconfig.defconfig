## app/boards/shields/aspara_flat/Kconfig.defconfig
```kconfig
# Copyright (c) 2026
# SPDX-License-Identifier: MIT

if SHIELD_ASPARA_FLAT_LEFT

config ZMK_KEYBOARD_NAME
    default "Aspara Flat"

config ZMK_SPLIT_ROLE_CENTRAL
    default y

config ZMK_USB
    default y

endif

if SHIELD_ASPARA_FLAT_LEFT || SHIELD_ASPARA_FLAT_RIGHT

config ZMK_SPLIT
    default y

config ZMK_BLE
    default y

endif
```

## app/boards/shields/aspara_flat/Kconfig.shield
```kconfig
# Copyright (c) 2026
# SPDX-License-Identifier: MIT

config SHIELD_ASPARA_FLAT_LEFT
    def_bool $(shields_list_contains,aspara_flat_left)

config SHIELD_ASPARA_FLAT_RIGHT
    def_bool $(shields_list_contains,aspara_flat_right)
```

## app/src/indicators/Kconfig.rgb_indicator
```kconfig
# Copyright (c) 2026 The ZMK Contributors
# SPDX-License-Identifier: MIT

config ZMK_RGB_INDICATOR
    bool "RGB indicator"
    depends on ZMK_SPLIT
    depends on ZMK_SPLIT_BLE
    select LED_STRIP
    help
      Enable split RGB indicator support for boards that provide a
      zmk,underglow chosen LED strip node.
```
